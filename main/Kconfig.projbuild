## main/Kconfig.projbuild
```kconfig
# https://www.kernel.org/doc/html/latest/kbuild/kconfig-language.html
menu "wolffshots/esp32-warm-water config"
    config RELAY_ONE_PIN
        int "first pin for relay"
        default 18
        help
            the one pin for the relay
    config RELAY_TWO_PIN
        int "second pin for relay"
        default 19
        help
            the two pin for the relay
    config STATUS_ONE_PIN
        int "first status pin"
        default 27
        help
            pin for first status led
    config STATUS_TWO_PIN
        int "second status pin"
        default 12
        help
            pin for second status led
    config CONTROL_INTERVAL
        int "period in which to poll the sensor and check the status"
        default 5000
        help
            poll window for checking the temp sensor and setting the relay (in milliseconds)
    config INITIAL_GOAL_TEMP
        int "initial goal temp (as an int)"
        default 25
        help
            the initial goal temp for the system to boot up with
endmenu
```

## sdkconfig.defaults
```kconfig
CONFIG_PARTITION_TABLE_CUSTOM=y
CONFIG_PARTITION_TABLE_CUSTOM_FILENAME="components/esp32-spiffs/partitions.csv"
CONFIG_PARTITION_TABLE_FILENAME="components/esp32-spiffs/partitions.csv"
CONFIG_HTTPD_MAX_REQ_HDR_LEN=1024
CONFIG_ESPTOOLPY_FLASHSIZE_8MB=y
CONFIG_ESPTOOLPY_FLASHSIZE="8MB"
```
